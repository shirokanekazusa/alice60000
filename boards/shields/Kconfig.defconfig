## boards/shields/Kconfig.defconfig
```kconfig
# Copyright (c) 2021 The ZMK Contributors
# SPDX-License-Identifier: MIT

if SHIELD_ALICE60

config ZMK_KEYBOARD_NAME
    default "alice60"

endif
```

## boards/shields/Kconfig.shield
```kconfig
# Copyright (c) 2021 The ZMK Contributors
# SPDX-License-Identifier: MIT

config SHIELD_ALICE60
    def_bool $(shields_list_contains,alice60)
```
